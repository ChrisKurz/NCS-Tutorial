## NCS/NCSv2.5.2/Workspace/board_1/MyBoards/boards/arm/my_test_board/Kconfig.defconfig
```kconfig
# Copyright (c) 2024 Nordic Semiconductor ASA
# SPDX-License-Identifier: Apache-2.0

if BOARD_MY_TEST_BOARD

config BOARD
	default "my_test_board"

config BT_CTLR
   default BT

endif
```

## NCS/NCSv3.2.0/ZHW_hardware_info/build_1/Kconfig/boards/Kconfig.defconfig
```kconfig
# Load Zephyr board defconfig descriptions.
osource "C:/Nordic/NCS/v3.2.0/zephyr/boards/nordic/nrf54l15dk/Kconfig.defconfig"
```

## NCS/NCSv3.2.0/ZHW_hardware_info/build_1/ZHW_hardware_info/Kconfig/boards/Kconfig.sysbuild
```kconfig
# Load Sysbuild board Kconfig descriptions.
osource "C:/Nordic/NCS/v3.2.0/zephyr/boards/nordic/nrf54l15dk/Kconfig.sysbuild"
```

## NCS/NCSv3.4.0-LTS/DEV_kconfig_UserDefined/Kconfig
```kconfig
# MyApp configuration
menu "MyApp Settings"
   config MYFUNC
         bool "Enable MyFunc software module"
         default y
         help 
            Include the user-defined software
      

   config MYFUNC_NAME
         string "Name of my function."
        default "name is not defined"
        depends on MYFUNC
        help 
            Name of the user-defined software.
endmenu

menu "Zephyr Kernel"
  source "Kconfig.zephyr"
endmenu
```
