/* Configuration of a BME280 device on an Arduino I2C bus.
   -------------------------------------------------------
   Device Address 0x76 is used here. 
   Selected pins (Arduino I2C bus default pins - I2C0):
        SCL  ->  P0.27
        SDA  ->  P0.26
*/    
&arduino_i2c {
    status = "okay";
    bme280@76 {
            compatible = "bosch,bme280";
            reg = <0x76>;
    };
};
