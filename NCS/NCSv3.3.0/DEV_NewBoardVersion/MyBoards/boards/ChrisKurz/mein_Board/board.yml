## NCS/NCSv3.3.0/DEV_NewBoardVersion/MyBoards/boards/ChrisKurz/mein_Board/board.yml
```yaml
board:
  name: mein_Board
  full_name: mein_Board
  vendor: ChrisKurz
  socs:
  - name: nrf5340
    variants:
    - name: ns
      cpucluster: cpuapp
  revision:
    format: major.minor.patch
    default: 1.0.0
    exact: true
    revisions:
      - name: 1.0.0  # original version
      - name: 1.1.0  # new version
```

## NCS/NCSv3.4.0-LTS/DEV_NewBoard/MyBoards/boards/ChrisKurz/mein_Board/board.yml
```yaml
board:
  name: mein_Board
  full_name: mein_Board
  vendor: ChrisKurz
  socs:
  - name: nrf5340
    variants:
    - name: ns
      cpucluster: cpuapp
```

## NCS/NCSv3.4.0-LTS/DEV_NewBoardVersion/MyBoards/boards/ChrisKurz/mein_Board/Kconfig.mein_Board
```kconfig
config BOARD_MEIN_BOARD
	select SOC_NRF5340_CPUAPP_QKAA if BOARD_MEIN_BOARD_NRF5340_CPUAPP || \
		BOARD_MEIN_BOARD_NRF5340_CPUAPP_NS
	select SOC_NRF5340_CPUNET_QKAA if BOARD_MEIN_BOARD_NRF5340_CPUNET
```
