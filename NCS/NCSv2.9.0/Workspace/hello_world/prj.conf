## prj.conf
```kconfig
# This line is just a comment. In this simple project we use the default configuration. 
```

## src/main.c
```c
#include <zephyr/kernel.h>

int main(void)
{
     printk("Hello World!\n");

     return 0;
}
```
