## prj.conf
```kconfig
# Enable Bluetooth support
CONFIG_BT=y

#------ Define Bluetooth LE Role 
#CONFIG_BT_BROADCASTER=y   # note: BROADCASTER is activated by default
#CONFIG_BT_CENTRAL=n       not used in this example
#CONFIG_BT_OBSERVER=n      not used in this example
CONFIG_BT_PERIPHERAL=y

#------ Define Bluetooth Device Name
CONFIG_BT_DEVICE_NAME="DIS peripheral"

#------ Device Information Service (DIS)
CONFIG_BT_DIS=y

#CONFIG_BT_DIS_MANUF="Zephyr"         ->   *** deprecated KCONFIG symbol ***
CONFIG_BT_DIS_MANUF_NAME=y
CONFIG_BT_DIS_MANUF_NAME_STR="Nordic Semiconductor"   
#CONFIG_BT_DIS_MODEL="Zephyr Model"   ->  *** deprecated KCONFIG symbol ***
CONFIG_BT_DIS_MODEL_NUMBER=y
CONFIG_BT_DIS_MODEL_NUMBER_STR="Zephyr Model"      
CONFIG_BT_DIS_SERIAL_NUMBER=y
CONFIG_BT_DIS_SERIAL_NUMBER_STR="Zephyr Serial"
CONFIG_BT_DIS_HW_REV=y
CONFIG_BT_DIS_HW_REV_STR="Zephyr Hardware Version"
CONFIG_BT_DIS_FW_REV=y
CONFIG_BT_DIS_FW_REV_STR="Zephyr Firmware Version"
CONFIG_BT_DIS_SW_REV=y
CONFIG_BT_DIS_SW_REV_STR="Zephyr Software Version"  
CONFIG_BT_DIS_PNP=n
#CONFIG_BT_DIS_PNP_PID=0x00   not used in this example
#CONFIG_BT_DIS_PNP_VID=0x00   not used in this example
#CONFIG_BT_DIS_PNP_VID_SRC=1  not used in this example
#CONFIG_BT_DIS_PNP_VER=0x01   not used in this example

#------ Nordic's UART Service (NUS)
CONFIG_BT_ZEPHYR_NUS=y
```

## src/main.c
```c
#include <zephyr/kernel.h>
#include <zephyr/bluetooth/services/dis.h>
#include <zephyr/bluetooth/uuid.h>
#include <zephyr/bluetooth/conn.h> 
#include <zephyr/bluetooth/services/nus.h>


static void notif_enabled(bool enabled, void *ctx)
{
    ARG_UNUSED(ctx);

    printk("%s() - %s\n", __func__, (enabled ? "Enabled" : "Disabled"));
}

static void received(struct bt_conn *conn, const void *data, uint16_t len, void *ctx)
{
    ARG_UNUSED(conn);
    ARG_UNUSED(ctx);

    printk("%s() - Len: %d, Message: %.*s\n", __func__, len, len, (char *)data);
}

struct bt_nus_cb nus_listener = {
   .notif_enabled = notif_enabled,
   .received = received,
};

/* Set advertising data */
static const struct bt_data ad[] = {
     BT_DATA_BYTES(BT_DATA_FLAGS, (BT_LE_AD_GENERAL | BT_LE_AD_NO_BREDR)),
     BT_DATA_BYTES(BT_DATA_UUID16_ALL, BT_UUID_16_ENCODE(BT_UUID_DIS_VAL)),
};

/* Set Scan Response data */
static const struct bt_data sd[] = {
	BT_DATA(BT_DATA_NAME_COMPLETE, CONFIG_BT_DEVICE_NAME, sizeof(CONFIG_BT_DEVICE_NAME) - 1),
};

void start_advertising(void)
{
     int err;

     err = bt_le_adv_start(BT_LE_ADV_CONN_FAST_1, ad, ARRAY_SIZE(ad),
                                                  sd, ARRAY_SIZE(sd));
     if (err) {
         printk("Advertising failed to start (err %d)\n", err);
     }
     else {
         printk("Advertising successfully started\n");
     }
}

static void connected(struct bt_conn *conn, uint8_t err)
{
     if (err) {
          printk("Connection failed (err 0x%02x)\n", err);
     } else {
          printk("Connected\n");
     }
}

static void disconnected(struct bt_conn *conn, uint8_t reason)
{
     printk("Disconnected (reason 0x%02x)\n", reason);
     start_advertising();    
}

/* Register a callback structure for connection events. */
BT_CONN_CB_DEFINE(conn_callbacks) = {
    .connected = connected,
    .disconnected = disconnected,
};

int main(void)
{
     printk("Hello World! Bluetooth DIS sample.\n");

     int err;

     /* Initialize the Bluetooth Subsystem */
     err = bt_enable(NULL);
     if (err) {
         printk("Bluetooth init failed (err %d)\n", err);
         return 0;
     }
     printk("Bluetooth initialized\n");

     err = bt_nus_cb_register(&nus_listener, NULL);
     if (err) {
         printk("Failed to register NUS callback: %d\n", err);
         return err;
     }

     start_advertising();

     while (true) {
         const char *hello_world = "Hello World!\n";

         err = bt_nus_send(NULL, hello_world, strlen(hello_world));
         printk("Data send - Result: %d\n", err);

         if (err < 0 && (err != -EAGAIN) && (err != -ENOTCONN)) {
             return err;
         }

         k_sleep(K_SECONDS(3));
     }

     return 0;
}
```
