## prj.conf
```kconfig
# Enable Bluetooth support
CONFIG_BT=y

#------ Define Bluetooth LE Role 
#CONFIG_BT_BROADCASTER=y   # note: BROADCASTER is activated by default
#CONFIG_BT_CENTRAL=n       not used in this example
#CONFIG_BT_OBSERVER=n      not used in this example
CONFIG_BT_PERIPHERAL=y

#------ Define Bluetooth Device Name
CONFIG_BT_DEVICE_NAME="Custom Service Peripheral"

#------ Device Information Service (DIS)
CONFIG_BT_DIS=y

#CONFIG_BT_DIS_MANUF="Zephyr"         ->   *** deprecated KCONFIG symbol ***
CONFIG_BT_DIS_MANUF_NAME=y
CONFIG_BT_DIS_MANUF_NAME_STR="Zephyr"   
#CONFIG_BT_DIS_MODEL="Zephyr Model"   ->  *** deprecated KCONFIG symbol ***
CONFIG_BT_DIS_MODEL_NUMBER=y
CONFIG_BT_DIS_MODEL_NUMBER_STR="Zephyr Model"      
CONFIG_BT_DIS_SERIAL_NUMBER=y
CONFIG_BT_DIS_SERIAL_NUMBER_STR="Zephyr Serial"
CONFIG_BT_DIS_HW_REV=y
CONFIG_BT_DIS_HW_REV_STR="Zephyr Hardware"
CONFIG_BT_DIS_FW_REV=y
CONFIG_BT_DIS_FW_REV_STR="Zephyr Firmware"
CONFIG_BT_DIS_SW_REV=y
CONFIG_BT_DIS_SW_REV_STR="Zephyr Software"
CONFIG_BT_DIS_PNP=n
#CONFIG_BT_DIS_PNP_PID=0x00   not used in this example
#CONFIG_BT_DIS_PNP_VID=0x00   not used in this example
#CONFIG_BT_DIS_PNP_VID_SRC=1  not used in this example
#CONFIG_BT_DIS_PNP_VER=0x01   not used in this example
```

## src/main.c
```c
#include <zephyr/kernel.h>
#include <zephyr/bluetooth/services/dis.h>
#include <zephyr/bluetooth/uuid.h>
#include <zephyr/bluetooth/conn.h> 
#include "../services/CustomService.h"

/* Set advertising data */
static const struct bt_data ad[] = {
     BT_DATA_BYTES(BT_DATA_FLAGS, (BT_LE_AD_GENERAL | BT_LE_AD_NO_BREDR)),
     BT_DATA_BYTES(BT_DATA_UUID16_ALL, BT_UUID_16_ENCODE(BT_UUID_DIS_VAL)),
};

/* Set Scan Response data */
static const struct bt_data sd[] = {
	BT_DATA(BT_DATA_NAME_COMPLETE, CONFIG_BT_DEVICE_NAME, sizeof(CONFIG_BT_DEVICE_NAME) - 1),
};

void start_advertising(void)
{
     int err;

     err = bt_le_adv_start(BT_LE_ADV_CONN_FAST_1, ad, ARRAY_SIZE(ad),
                                                  sd, ARRAY_SIZE(sd));
     if (err) {
         printk("Advertising failed to start (err %d)\n", err);
     }
     else {
         printk("Advertising successfully started\n");
     }
}

static void connected(struct bt_conn *conn, uint8_t err)
{
     if (err) {
          printk("Connection failed (err 0x%02x)\n", err);
     } else {
          printk("Connected\n");
     }
}

static void disconnected(struct bt_conn *conn, uint8_t reason)
{
     printk("Disconnected (reason 0x%02x)\n", reason);
}

static void recycled_cb(void)
{
    printk("Connection object available from previous conn. Disconnect is complete!\n");
    start_advertising();
}

/* Register a callback structure for connection events. */
BT_CONN_CB_DEFINE(conn_callbacks) = {
    .connected = connected,
    .disconnected = disconnected,
	.recycled = recycled_cb,
};

int main(void)
{
     printk("Hello World! Bluetooth DIS sample.\n");

     int err;

     /* Initialize the Bluetooth Subsystem */
     err = bt_enable(NULL);
     if (err) {
         printk("Bluetooth init failed (err %d)\n", err);
         return 0;
     }
     printk("Bluetooth initialized\n");

     //Initalize services
     err = CustomService_init();
     if (err) {
         printk("Custom Service initialization failed!\n");
         return 0;
     }

     start_advertising();

     return 0;
}
```
