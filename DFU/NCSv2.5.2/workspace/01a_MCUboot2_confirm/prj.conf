## prj.conf
```kconfig
CONFIG_BOOTLOADER_MCUBOOT=y

CONFIG_MCUBOOT_EXTRA_IMGTOOL_ARGS="--confirm"
CONFIG_MCUBOOT_GENERATE_CONFIRMED_IMAGE=y
```

## src/main.c
```c
/*
 * Copyright (c) 2012-2014 Wind River Systems, Inc.
 *
 * SPDX-License-Identifier: Apache-2.0
 */

#include <stdio.h>

int main(void)
{
	printf("Hello World! %s\n", CONFIG_BOARD);
    printf("Image: MCUboot2 (confirmed) \n");	
	return 0;
}
```
