## prj.conf
```kconfig
# nothing here

CONFIG_BOOTLOADER_MCUBOOT=y

# Confirm the upgrade image. This causes to use swap type "permanent"
CONFIG_MCUBOOT_EXTRA_IMGTOOL_ARGS="--confirm"
```

## src/main.c
```c
/*
 * Copyright (c) 2012-2014 Wind River Systems, Inc.
 *
 * SPDX-License-Identifier: Apache-2.0
 */

#include <zephyr/kernel.h>

void main(void)
{
    printk("Hello World! %s\n", CONFIG_BOARD);
    printk("Image: MCUboot2 (confirmed) \n");	
}
```
