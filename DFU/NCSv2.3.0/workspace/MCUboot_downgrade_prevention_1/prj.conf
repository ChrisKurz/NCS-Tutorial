## CMakeLists.txt
```
# SPDX-License-Identifier: Apache-2.0

cmake_minimum_required(VERSION 3.20.0)

find_package(Zephyr REQUIRED HINTS $ENV{ZEPHYR_BASE})
project(MCUboot_DowngradePrevention)

target_sources(app PRIVATE src/main.c)
```

## prj.conf
```kconfig
CONFIG_BOOTLOADER_MCUBOOT=y

# Confirm the upgrade image. This causes to use swap type "permanent"
CONFIG_MCUBOOT_EXTRA_IMGTOOL_ARGS="--confirm"

# Version number of software image (Change this version number to generate the different test images)
CONFIG_MCUBOOT_IMAGE_VERSION="0.1.2+3"        
```

## src/main.c
```c
/*
 * Copyright (c) 2012-2014 Wind River Systems, Inc.
 *
 * SPDX-License-Identifier: Apache-2.0
 */

#include <zephyr/kernel.h>
void main(void)
{
	printk("Hello World! %s\n", CONFIG_BOARD);
    printk("Image Firmware Version v%s \n", CONFIG_MCUBOOT_IMAGE_VERSION);
}
```
