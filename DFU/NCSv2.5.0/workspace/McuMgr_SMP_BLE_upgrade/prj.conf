## prj.conf
```kconfig
# Add MCUboot to the project
CONFIG_BOOTLOADER_MCUBOOT=y

# Add McuMgr SMP Server
CONFIG_MCUMGR=y
CONFIG_MCUMGR_GRP_IMG=y

# CONFIG_MCUMGR_GRP_IMG dependencies
CONFIG_FLASH=y
CONFIG_IMG_MANAGER=y

# CONFIG_IMG_MANAGER dependencies
CONFIG_STREAM_FLASH=y

# CONFIG_MCUMGR dependencies
CONFIG_NET_BUF=y
CONFIG_ZCBOR=y

# Required for CONFIG_IMG_MANAGER
CONFIG_FLASH_MAP=y

# Enable BLE transfer
CONFIG_BT=y
CONFIG_BT_PERIPHERAL=y
CONFIG_BT_DEVICE_NAME="DFU Sample"
CONFIG_NCS_SAMPLE_MCUMGR_BT_OTA_DFU=y

CONFIG_NCS_SAMPLE_MCUMGR_BT_OTA_DFU=y
CONFIG_NCS_SAMPLE_MCUMGR_BT_OTA_DFU_SPEEDUP=y
```

## src/main.c
```c
#include <zephyr/kernel.h>
#include "mcumgr_smp_bluetooth.h"

int main(void)
{
    printk("Hello World!\n");
    printf("Image: upgrade SMP BLE image \n");

    start_mcumgr_smp_bluetooth();   

    return 0;     
}
```
